#include <behaviors.dtsi>
#include <behaviors/mouse_keys.dtsi>
#include <dt-bindings/zmk/keys.h>
#include <dt-bindings/zmk/bt.h>
#include <dt-bindings/zmk/rgb.h>
#include <dt-bindings/zmk/outputs.h>
#include <dt-bindings/zmk/ext_power.h>

#include "jso.h"

#include <dt-bindings/zmk/pointing.h>

/ {
  keymap {
    compatible = "zmk,keymap";
#define JSO_X(LAYER, STRING) \
    LAYER { \
      display-name = STRING; \
      bindings = < JSO_LAYER_BINDINGS_##LAYER >; \
    };
JSO_X(BASE,   "COLEMAK") 
JSO_X(ALTER,  "QWERTY") 
JSO_X(EXTRA,  "IRST") 
JSO_X(OPT,    "OCTA8") 
JSO_X(NUM,    "NUMERIC") 
JSO_X(SYM,    "SYMBOLS") 
JSO_X(FUNC,   "FUNCTIONS") 
JSO_X(NAV,    "NAVIGATION") 
JSO_X(MOUSE,  "MOUSE") 
JSO_X(MEDIA,  "MEDIA") 
JSO_X(LOWER,  "LOWER") 
JSO_X(RAISE,  "RAISE") 
JSO_X(ADJUST, "ADJUST") 
#undef JSO_X
  };

  conditional_layers {
    compatible = "zmk,conditional-layers";

    adjust_condition {
      if-layers = <L_LOWER L_RAISE>;
      then-layer = <L_ADJUST>;
    };
  };
};

#include "jso_double_tap.dtsi"
#include "jso_mousekeys.dtsi"
#include "jso_combos.dtsi"
#include "jso_behaviors.dtsi"
#include "jso_macros.dtsi"