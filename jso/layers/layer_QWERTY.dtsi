
        qwerty {
            // -----------------------------------------------------------------------------------------
            // |  TAB |  Q  |  W  |  E  |  R  |  T  |        |  Y  |  U   |  I  |  O  |  P  | BKSP |
            // | CTRL |  A  |  S  |  D  |  F  |  G  |        |  H  |  J   |  K  |  L  |  ;  |  '   |
            // | SHFT |  Z  |  X  |  C  |  V  |  B  |        |  N  |  M   |  ,  |  .  |  /  | ESC  |
            //                    | GUI | LWR | SPC |        | ENT | RSE  | ALT |

            display-name = "QWERTY";
            bindings = <
&kp TAB    &kp Q        &kp W        &kp E         &kp R         &kp T        &kp Y    &kp U         &kp I         &kp O        &kp P           &kp BSPC
&kp LCTRL  HRL(LGUI, A)  HRL(LALT, S)  HRL(LCTRL, D)  HRL(LSHFT, F)  &kp G    &kp H    HRR(RSHFT, J)  HRR(RCTRL, K)  HRR(RALT, L)  HRR(RGUI, SEMI)  &kp SQT
&kp LSHFT  &kp Z        &kp X        &kp C         &kp V         &kp B        &kp N    &kp M         &kp COMMA     &kp DOT      &kp FSLH        &kp ESC
                                     &kp LGUI      &mo L_LOWER   &kp SPACE    &kp RET  &mo L_RAISE   &kp RALT
            >;
        };

/*
QWERTY:
1 2 3 4 5  6 7 8 9 0 - =
Q W E R T  Y U I O P [ ] \
A S D F G  H J K L ; '
Z X C V B  N M , . /
*/