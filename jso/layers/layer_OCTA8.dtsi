        octa8 {
            // -----------------------------------------------------------------------------------------
            // |  TAB |  Y  |  O  |  U  |  K  |  X  |         |  G  |  W   |  D  |  L  |  ,  | BSPC |
            // | BKSP |  I  |  A  |  E  |  N  |  F  |         |  B  |  S   |  T  |  R  |  C  |  ;   |
            // |   |  |  /  |  Z  |  H  |  '  |  Q  |         |  V  |  P   |  M  |  J  |  .  | ESC  |
            //                    | ESC | SPC | TAB |         | ENT | BSPC | DEL |

            display-name = "Octa8";
            bindings = <
&kp TAB   &kp Y        &kp O        &kp U          &kp K          &kp X            &kp G          &kp W         &kp D         &kp L        &kp COMMA    &kp BSPC
&kp BSPC  HRL(LGUI, I)  HRL(LALT, A)  HRL(LCTRL, E)   HRL(LSHFT, N)   &kp F        &kp B          HRR(RSHFT, S)  HRR(RCTRL, T)  HRR(RALT, R)  HRR(RGUI, C)  &kp SEMI
&kp PIPE  &kp SLASH    &kp Z        &kp H          &kp SQT        &kp Q            &kp V          &kp P         &kp M         &kp J        &kp DOT      &kp ESC
                       B_LT(L_MEDIA, ESC)  B_LT(L_NAV, SPACE)  B_LT(L_MOUSE, TAB)        B_LT(L_SYM, ENTER)  B_LT(L_NUM, BSPC)   B_LT(L_FUNC, DEL)
            >;
        };

/*
OCTA8:
y o u k x  	g w d l ,
i a e n f  	b s t r c ;
/ z h ' q  	v p m j .
*/