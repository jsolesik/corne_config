        lower {
            // -----------------------------------------------------------------------------------------
            // |      |  {  |  &  |  *  |  (  |  }  |           |     |     |     |     |     |      |
            // |      |  +  |  $  |  %  |  ^  |  +  |           |     | SFT | CTR | ALT | GUI |      |
            // |      |  ~  |  !  |  @  |  #  |  |  |           |     |     |     |     |     |      |
            //                    |  (  |  )  |  _  |           |     |     |     |

            display-name = "LOWER";
            bindings = <
&kp ESC    &none                 &kp N7  &kp N8    &kp N9     &kp PAGE_UP           &kp LG(LS(J))      &kp LC(LS(TAB))  &kp LC(TAB)   &none         TO(BASE)                 &kp DELETE
&kp LCTRL  &none                 &kp N4  &kp N5    &kp N6     &kp PAGE_DOWN         &kp LEFT           &kp DOWN         &kp UP        &kp RIGHT     &none                 &kp RET
&kp LSHFT  &kp LC(LS(LA(LGUI)))  &kp N1  &kp N2    &kp N3     &kp N0                &kp C_VOL_DN       &kp C_VOL_UP     &kp C_BRI_DN  &kp C_BRI_UP  &kp LC(LS(LA(LGUI)))  &kp LG(LSHFT)
                                         &kp LGUI  &trans L_ALTER  &kp SPACE        &kp LG(LA(SPACE))  &trans        &kp RALT
            >;
        };

