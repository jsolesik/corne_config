        media {
            // -----------------------------------------------------------------------------------------
            // |      |     |     |     |     |     |           |     |      | B_DN | B_UP |      |        |
            // |      | GUI | ALT | CTR | SFT |     |           | EP  | PREV | V_DN | V_UP | NEXT |        |
            // |      |     |     |     |     |     |           | OUT | BT_0 | BT_1 | BT_2 | BT_3 | BT_CLR |
            //                    |     |     |     |           | STOP | PPLAY | MUTE |

            display-name = "MEDIA";
            bindings = <
&none     TO(OPT)        TO(EXTRA)  TO(ALTER)   TO(BASE)    &none       &none              &none             &kp C_BRI_DN  &kp C_BRI_UP  &none         &none
&none     &kp LGUI      &kp LALT  &kp LCTRL  &kp LSHFT  &none       &ext_power EP_TOG  &kp C_PREV        &kp C_VOL_DN  &kp C_VOL_UP  &kp C_NEXT    &none
&none     &none  &none     TO(FUN)     TO(MEDIA)   &none       &out OUT_TOG       &bt BT_SEL 0      &bt BT_SEL 1  &bt BT_SEL 2  &bt BT_SEL 3  &bt BT_CLR
                                  &none      &none      &none       &kp C_STOP         &kp C_PLAY_PAUSE  &kp C_MUTE
            >;
        };
