        numeric {
            // -----------------------------------------------------------------------------------------
            // |      |  [  |  6  |  7  |  9  |  ]  |           |     |     |     |     |     |      |
            // |      |  ;  |  4  |  5  |  6  |  =  |           |     | SFT | CTR | ALT | GUI |      |
            // |      |  `  |  1  |  2  |  3  |  \  |           |     |     |     |     |     |      |
            //                    |  .  |  0  |  -  |           |     |     |     |

            display-name = "NUM";
            bindings = <
&none  &kp LBKT &kp N7 &kp N8 &kp N9 &kp RBKT &none B_TO(BASE) B_TO(ALTER) B_TO(EXTRA) B_TO(OPT) &none
&none  &kp SEMI &kp N4 &kp N5 &kp N6 &kp EQUAL &none &kp RSHFT &kp RCTRL &kp RALT &kp RGUI &none
&none  &kp GRAVE &kp N1 &kp N2 &kp N3 &kp BLSH &none B_TO(NUM) B_TO(NAV) &none &none &none
&kp DOT  &kp N0 &kp MINUS &none &none &none
            >;
        };
