        mouse {
            // -----------------------------------------------------------------------------------------
            // |      |     |     |     |     |     |           |     |      | B_DN | B_UP |      |        |
            // |      | GUI | ALT | CTR | SFT |     |           | EP  | PREV | V_DN | V_UP | NEXT |        |
            // |      |     |     |     |     |     |           | OUT | BT_0 | BT_1 | BT_2 | BT_3 | BT_CLR |
            //                    |     |     |     |           | STOP | PPLAY | MUTE |

            display-name = "MOUSE";
            bindings = <
&none     B_TO(OPT)        B_TO(EXTRA)  B_TO(ALTER)   B_TO(BASE)    &none       &kp K_REDO  &kp K_PASTE     &kp K_COPY      &kp K_CUT     &kp K_UNDO       &none
&none     &kp LGUI      &kp LALT  &kp LCTRL  &kp LSHFT  &none       &none       &mmv MOVE_LEFT  &mmv MOVE_DOWN  &mmv MOVE_UP  &mmv MOVE_RIGHT  &none
&none     &none  &none     B_TO(SYM)     B_TO(MOUSE)   &none       &none       &msc SCRL_LEFT  &msc SCRL_DOWN  &msc SCRL_UP  &msc SCRL_RIGHT  &none
                                  &none      &none      &none       &mkp M2     &mkp M1         &mkp M3
            >;
        };

